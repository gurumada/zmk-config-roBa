## dts/bindings/input_processors/gurumada,input-processor-key-guard.yaml
```yaml
description: Suppress trackball movement and scrolling unless the physical M key is pressed

compatible: "gurumada,input-processor-key-guard"

include: ip_zero_param.yaml
```
